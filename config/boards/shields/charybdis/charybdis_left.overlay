/*
 * Copyright (c) 2020 ZMK Contributors
 *
 * SPDX-License-Identifier: MIT
 */

#include "charybdis.dtsi"

&kscan0 {
	col-gpios
		= <&gpio0 17 (GPIO_ACTIVE_HIGH | GPIO_PULL_DOWN)>
		, <&gpio0 20 (GPIO_ACTIVE_HIGH | GPIO_PULL_DOWN)>
		, <&gpio0 22 (GPIO_ACTIVE_HIGH | GPIO_PULL_DOWN)>
		, <&gpio0 24  (GPIO_ACTIVE_HIGH | GPIO_PULL_DOWN)>
		, <&gpio1 0 (GPIO_ACTIVE_HIGH | GPIO_PULL_DOWN)>
		, <&gpio1 04  (GPIO_ACTIVE_HIGH | GPIO_PULL_DOWN)>
		;
};
