## config/boards/shields/charybdis/Kconfig.defconfig
```kconfig
if SHIELD_charybdis_RIGHT

config ZMK_KEYBOARD_NAME
	default "charybdis"

config ZMK_SPLIT_BLE_ROLE_CENTRAL
	default y

endif

if SHIELD_charybdis_LEFT || SHIELD_charybdis_RIGHT

config ZMK_SPLIT
	default y



endif
```

## config/west.yml
```yaml
manifest:
  remotes:
    - name: zmkfirmware
      url-base: https://github.com/DoctorWangWang
  projects:
    - name: 64key-3610
      remote: zmkfirmware
      revision: 64key-3610-automouse
      import: app/west.yml
  self:
    path: config
```
